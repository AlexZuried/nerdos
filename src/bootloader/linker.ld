/*
 * NerdOS Linker Script
 *
 * This script defines the memory layout of the NerdOS kernel.
 * It places sections in the following order:
 *
 *   1. .multiboot2_header - Multiboot2 header (must be in first 32KB)
 *   2. .text              - Code (read-only, executable)
 *   3. .rodata            - Read-only data (constants, strings)
 *   4. .data              - Initialized mutable data
 *   5. .bss               - Zero-initialized mutable data
 *
 * Memory Layout:
 *   0x00100000 - 0x00FFFFFF : Kernel image (16 MiB)
 *   0x01000000 - ...       : Heap
 */

ENTRY(_start)

/* Kernel is loaded at 1MB (standard for x86 kernels) */
KERNEL_VMA = 0x100000;

SECTIONS
{
    /* Start at 1MB */
    . = KERNEL_VMA;

    /*
     * .text section - executable code
     * Contains: boot.asm, all Rust code
     * Flags: read-only, executable
     */
    .text : ALIGN(4K)
    {
        /* Multiboot2 header must be in the first 8KB */
        *(.multiboot2_header)

        /* Text sections from all input files */
        *(.text .text.*)
        *(.gnu.linkonce.t.*)
    }

    /*
     * .rodata section - read-only data
     * Contains: string literals, constants, vtables
     * Flags: read-only, non-executable
     */
    .rodata : ALIGN(4K)
    {
        *(.rodata .rodata.*)
        *(.gnu.linkonce.r.*)

        /* For Rust: vtables and other read-only data */
        *(.got .got.*)

        /* For Rust LTO: merged sections */
        *(.ldata .ldata.*)
    }

    /*
     * .data section - initialized data
     * Contains: global/static variables with initial values
     * Flags: read-write
     */
    .data : ALIGN(4K)
    {
        *(.data .data.*)
        *(.gnu.linkonce.d.*)
    }

    /*
     * .bss section - uninitialized data
     * Contains: global/static variables with no initial value (zero-initialized)
     * The bootloader zeroes this before calling kernel_main.
     *
     * NOTE: GRUB does NOT zero the BSS for us. The kernel must do this,
     * OR we can rely on the .bss being in the loaded segment.
     */
    .bss : ALIGN(4K)
    {
        __bss_start = .;
        *(.bss .bss.*)
        *(.gnu.linkonce.b.*)
        *(COMMON)
        __bss_end = .;
    }

    /*
     * End of the kernel image
     * Anything after this is heap/stack space
     */
    __kernel_end = .;

    /*
     * Discard unnecessary sections to save space.
     * These sections are generated by the compiler but not needed
     * in a kernel binary.
     */
    /DISCARD/ :
    {
        /* Comment sections (debug info, etc.) */
        *(.comment)
        *(.comment.*)

        /* Note sections */
        *(.note)
        *(.note.*)

        /* GCC exception tables (we don't use C++ exceptions) */
        *(.eh_frame)
        *(.eh_frame.*)

        /* Build ID (we generate our own) */
        *(.note.gnu.build-id)

        /* Debug sections (separate debug info is preferred) */
        *(.debug_*)
    }
}
